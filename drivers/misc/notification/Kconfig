## drivers/misc/notification/Kconfig
```kconfig
#
# Unprivileged Configuration Interface
#
menu "UCI Notifications Module"
config UCI_NOTIFICATIONS
       default y
       tristate "UCI notifications module"

config UCI_NOTIFICATIONS_SCREEN_CALLBACKS
       default n
       bool "UCI notifications should expose screen state callbacks"
       depends on UCI_NOTIFICATIONS

endmenu
```
